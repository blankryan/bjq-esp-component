## drivers/bjq_mfrc522/Kconfig
```kconfig
menu "Bojaqu MFRC522 Configuration"

    config BJQ_MFRC522_DEFAULT_SPI_CLOCK_HZ
        int "Default SPI clock frequency (Hz)"
        default 4000000
        range 100000 10000000
        help
            Default SPI bus clock speed used when runtime spi_clock_hz is 0.
            The MFRC522 datasheet specifies a maximum SPI clock of 10 MHz.

    config BJQ_MFRC522_DEFAULT_TIMEOUT_MS
        int "Default transaction timeout (ms)"
        default 100
        range 1 5000
        help
            Default timeout in milliseconds for MFRC522 operations and polling waits.

    config BJQ_MFRC522_DEFAULT_RX_GAIN
        int "Default receiver antenna gain index (0..7)"
        default 4
        range 0 7
        help
            Default MFRC522 RFCfgReg RxGain setting applied during reset:
            0 = 18 dB, 1 = 23 dB, 2 = 18 dB, 3 = 23 dB,
            4 = 33 dB (datasheet default), 5 = 38 dB, 6 = 43 dB, 7 = 48 dB.

endmenu
```

## templates/component/Kconfig
```kconfig
menu "Bojaqu __COMPONENT_TITLE__ Configuration"

    config __COMPONENT_UPPER___DEFAULT_TIMEOUT_MS
        int "Default operation timeout (ms)"
        default 100
        range 1 60000
        help
            Default timeout in milliseconds used by __COMPONENT_NAME__ operations.

endmenu
```
